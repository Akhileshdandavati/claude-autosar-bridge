AUTOSAR XML (schema 00051)
package /Interfaces
  4 x sender receiver interface:
    EngineSpeedInterface
      data EngineSpeed: type=uint16_T
    ThrottleInterface
      data ThrottlePosition: type=uint8_T
    EngineSpeedOutInterface
      data EngineSpeedFwd: type=uint16_T
    ThrottleOutInterface
      data ThrottlePositionFwd: type=uint8_T
