AUTOSAR XML (schema 00051)
standard types defined: uint16, uint8
package /DataTypes/ImplementationDataTypes
  impl type uint16_T: category=VALUE, base-type=uint16
  impl type uint8_T: category=VALUE, base-type=uint8
