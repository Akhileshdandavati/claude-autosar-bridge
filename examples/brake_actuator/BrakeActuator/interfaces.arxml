AUTOSAR XML (schema 00051)
package /Interfaces
  sender receiver interface BrakeCommandInterface
    data BrakeTorque: type=float32_T
