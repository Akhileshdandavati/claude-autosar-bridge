AUTOSAR XML (schema 00051)
standard types defined: float32
package /DataTypes/ImplementationDataTypes
  impl type float32_T: category=VALUE, base-type=float32
