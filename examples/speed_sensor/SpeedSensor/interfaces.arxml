AUTOSAR XML (schema 00051)
package /Interfaces
  sender receiver interface SpeedSensorInterface
    data VehicleSpeed: type=uint16_T
