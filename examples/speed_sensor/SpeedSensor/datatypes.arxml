AUTOSAR XML (schema 00051)
standard types defined: uint16
package /DataTypes/ImplementationDataTypes
  impl type uint16_T: category=VALUE, base-type=uint16
